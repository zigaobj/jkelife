
#include <si4421.h>                 
enum status workmode;
//-----------------------------------------------------------------------------
//全局变量定义
//-----------------------------------------------------------------------------

uchar xdata dis_buf[32];
uchar xdata discode;//开关显示、光标、闪烁的命令字暂存单元

uchar xdata virt_port;

uchar code lcdbase[103][2]={{' ',0x20},{'!',0x21},{'#',0x23},{'$',0x24},
             {'%',0x25},{'&',0x26},{'(',0x28},{')',0x29},{'*',0x2a},
             {'+',0x2b},{',',0x2c},{'-',0x2d},{'.',0x2e},{'0',0x30},
             {'1',0x31},{'2',0x32},{'3',0x33},{'4',0x34},{'5',0x35},
             {'6',0x36},{'7',0x37},{'8',0x38},{'9',0x39},{':',0x3a},
             {';',0x3b},{'<',0x3c},{'=',0x3d},{'>',0x3e},{'?',0x3f},
             {'@',0x40},{'A',0x41},{'B',0x42},{'C',0x43},{'D',0x44},
             {'E',0x45},{'F',0x46},{'G',0x47},{'H',0x48},{'I',0x49},
             {'J',0x4a},{'K',0x4b},{'L',0x4c},{'M',0x4d},{'N',0x4e},
             {'O',0x4f},{'P',0x50},{'Q',0x51},{'R',0x52},{'S',0x53},
             {'T',0x54},{'U',0x55},{'V',0x56},{'W',0x57},{'X',0x58},
             {'Y',0x59},{'Z',0x5a},{'[',0x5b},{']',0x5d},{'_',0x5f},
             {'a',0x61},{'b',0x62},{'c',0x63},{'d',0x64},{'e',0x65},
             {'f',0x66},{'g',0x67},{'h',0x68},{'i',0x69},{'j',0x6a},
             {'k',0x6b},{'l',0x6c},{'m',0x6d},{'n',0x6e},{'o',0x6f},
             {'p',0x70},{'q',0x71},{'r',0x72},{'s',0x73},{'t',0x74},
             {'u',0x75},{'v',0x76},{'w',0x77},{'x',0x78},{'y',0x79},
             {'z',0x7a},{'|',0x7c},{'/',0x2f},{ 0 ,0x30},{ 1 ,0x31},
             { 2 ,0x32},{ 3 ,0x33},{ 4 ,0x34},{ 5 ,0x35},{ 6 ,0x36},
             { 7 ,0x37},{ 8 ,0x38},{ 9 ,0x39},{0x0a,0x61},{0x0b,0x62},
			 {0x0c,0x63},{0x0d,0x64},{0x0e,0x65},{0x0f,0x66}};

                               

 
//-----------------------------------------------------------------------------
//函数名称:      SYSCLK_Init ()
//函数功能:      系统时钟初始化
//入口参数:      无
//出口参数:      无
//全局变量引用:  无
//调用模块:      无 
//-----------------------------------------------------------------------------
//

//-----------------------------------------------------------------------------
//函数名称:      LCD_Init ()
//函数功能:      LCD初始化
//入口参数:      无
//出口参数:      无
//全局变量引用:  无
//调用模块:      无  
//-----------------------------------------------------------------------------


void LCD_Init(void)
{
   uint xdata x;

   LCDRS = 0;
   LCDE  = 1;
   for(x=0;x<50000;x++);
   //P7 = 0x30;				/*一行显示*/
   write_byte( 0x38);				/*两行显示*/
   LCDE  = 0;//0x08;
   LCDE  = 1;//0x09; 
   for(x=0;x<1000;x++);
   write_byte( 0x0e);
   LCDE  = 0;//0x08;
   LCDE  = 1;//0x09; 
   for(x=0;x<1000;x++);
   write_byte(0x06);
  LCDE  = 0;//0x08;
   LCDE  = 1;//0x09; 
   for(x=0;x<5000;x++);
   write_byte( 0x01);
  LCDE  = 0;//0x08;
   LCDE  = 1;//0x09; 
   for(x=0;x<5000;x++);
}

void write_byte(unsigned char wdata)      //74ls164
{
	unsigned char i;
	for (i=0;i<8;i++)
	{	
		SCLK = 0;
		wdata <<= 1;
		SDA = CY;
		SCLK = 1;
	}

}		


 void writecode(uchar ins)
 {
     
    LCDRS = 0;
	LCDE  = 1;
	write_byte(ins);
	LCDE  = 0;	 
  }

void writedata(uchar sdata)
{
    LCDRS = 1;
	LCDE  = 1;
	write_byte(sdata);
	LCDE  = 0;	 


 }

 void lcdchar (uchar ch)
 {
     uchar xdata i;
     for (i=0;lcdbase[i][0]!=ch;i++)
         {
         if (i>102)  //从0到102，
            {
            i=0x1c;
            break;   //若未找到，则显示？
            }
  } 
     writedata(lcdbase[i][1]);
     }

 void lcdaddr(uchar DDRAM)
 {
     if (DDRAM<=16)
     {
        writecode(0x80+DDRAM-1);
        }
     else 
     {    
        writecode(0x80+DDRAM+0x2f);
        }
 }


